#include <Adafruit_GFX.h>
#include <Adafruit_SSD1306.h>
#include <U8g2lib.h>
#include <Wire.h>

Adafruit_SSD1306 adafruitDisplay(128, 64, &Wire, -1);
U8G2_SSD1306_128X64_NONAME_1_HW_I2C oled(U8G2_R0, U8X8_PIN_NONE);

const unsigned char pongLogo [] PROGMEM = {
	0x00, 0x00, 0x00, 0x00, 0x00, 0x00, 0x00, 0x00, 0x00, 0x00, 0x00, 0x00, 0x00, 0x00, 0x00, 0x00, 
	0x00, 0x00, 0x00, 0x00, 0x00, 0x00, 0x00, 0x00, 0x00, 0x00, 0x00, 0x00, 0x00, 0x00, 0x00, 0x00, 
	0x00, 0x00, 0x00, 0x00, 0x00, 0x00, 0x00, 0x00, 0x00, 0x00, 0x00, 0x00, 0x00, 0x00, 0x00, 0x00, 
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	0x00, 0x00, 0x00, 0x00, 0x00, 0x00, 0x00, 0x00, 0x00, 0x00, 0x00, 0x00, 0x00, 0x00, 0x00, 0x00
};

const int yAxisPin1 = A0;
const int joystickButton = 16;

const int difficultyButton = 0;
const int resetButton = 2;

const int diode = 14;

const int buzzer = 12;

int radius = 2;
int x, y;
int xspeed, yspeed, userSpeed = 2, compSpeed = 1;
int userScore = 0, compScore = 0;

int border = 10;
int maxHeight = 63;
int maxWidth = 127;
int padWidth = 2;
int padHeight = 10;
int gameHeight = maxHeight - border;
int gameWidth = maxWidth - padWidth;

float userX = 0;
float userY = 30;

float compX = 126;
float compY = 30;

int success = 0;

String displayScore = "                   ";

void oled_prepare(void);
void move();
void display();

void setup(){
  pinMode(yAxisPin1, INPUT_PULLUP);

  pinMode(difficultyButton, INPUT);
  pinMode(resetButton, INPUT);
  
  pinMode(14, OUTPUT);

  pinMode(buzzer, OUTPUT);

  Serial.begin(9600);
  oled.begin();
  oled_prepare();
  adafruitDisplay.begin(SSD1306_SWITCHCAPVCC, 0x3C);
  adafruitDisplay.clearDisplay();
  adafruitDisplay.drawBitmap(0, 0, pongLogo, 128, 64, WHITE);
  adafruitDisplay.display();

  tone(buzzer, 1000);
  digitalWrite(14, HIGH);
  delay(2500);
  noTone(buzzer);
  digitalWrite(14, LOW);
  x = random(50, 70);
  xspeed = 1;
  y = random(border + radius + 5, 63 - 5);
  yspeed = 1;
}

void loop(){
  move();
  display();
}

void oled_prepare(void) {
  oled.setFont(u8g2_font_6x10_tf);
  oled.setFontRefHeightExtendedText();
  oled.setDrawColor(1);
  oled.setFontPosTop();
  oled.setFontDirection(0);
}

void move(){
  if(x + radius > gameWidth || x - radius < padWidth) xspeed =- xspeed;
  if(y + radius >= maxHeight || y - radius <= border) yspeed =- yspeed;

  x += xspeed;
  y += yspeed;

  if(analogRead(yAxisPin1) < 530){
    userY += userSpeed;
    if(userY >= gameHeight) userY = 53;
  }

  if(analogRead(yAxisPin1) > 550){
    userY -= userSpeed;
    if(userY <= border) userY = border;
  }

  if(xspeed) {
    if(yspeed > 0) compY += compSpeed;
    else compY -= compSpeed;

    if(compY >= gameHeight) compY = gameHeight;
    if(compY <= border) compY = border;
  }

  if(x - radius <= userX + 1) {
    if(!(y + radius >= userY && y - radius <= userY + padHeight)){
      compScore++;
      tone(buzzer, 500);
      delay(150);
      noTone(buzzer);
      delay(1000);
      x = random(50, 70);
      y = random(border + radius + 5, 63 - 5);
    }

    displayScore = String(userScore) + "                 " + String(compScore);
    success++;

    if(success > 9){
      if(xspeed > 0) xspeed++;
      else xspeed--;
      if(yspeed > 0) yspeed++;
      else yspeed--;
      success = 0;
      if(xspeed > 2 || yspeed > 2){
        xspeed = 2;
        yspeed = 2;
      }
      else if(xspeed <- 2 || yspeed <-2 ){
        xspeed = -2;
        yspeed = -2;
      }
    }
  }

  if((compX - 1) <= (x + radius)){
    if(!(y + radius >= compY && y - radius <= compY + padHeight)){
      userScore++;
      tone(buzzer, 2000);
      delay(150);
      noTone(buzzer);
      delay(1000);
      x = random(50,70);
      y = random(border + radius + 5, 63 - 5);
    }
  }
  displayScore = String(userScore) + "                 " + String(compScore);
}

void display(){
    oled.firstPage();
    do {
      oled.drawCircle(x, y, radius);
      oled.drawStr(8, 1, displayScore.c_str());

      oled.drawLine(0, border, 127, border);
      oled.drawLine(0, 63, 127, 63);

      for (int i = 3; i <= 63; i += 4) oled.drawVLine(64, i, 2);

      oled.drawBox(userX, userY, padWidth, padHeight);
      oled.drawBox(compX, compY, padWidth, padHeight);
    } while (oled.nextPage());

    if(userScore == 10){
      oled.firstPage();
      do {
        oled.drawStr(15, 5, "Wygrana!");
        oled.drawStr(30, 30, "Nacisnij B, aby");
        oled.drawStr(30, 50, "zagrac ponownie");
      } while(oled.nextPage());
      while(1){
        if(!(digitalRead(resetButton))) break;
        delay(20);
      }
      x = random(50, 70);
      y = random(border + radius + 5, maxHeight - 5);
      userScore = 0;
      compScore = 0;
      xspeed = 1;
      yspeed = 1;
    }
    else if(compScore == 10){
      oled.firstPage();
      do{
        oled.drawStr(15, 5, "Przegrana");
        oled.drawStr(30, 35, "Nacisnij B, aby");
        oled.drawStr(30, 50, "zagrac ponownie");
      } while(oled.nextPage());
      while(1){
        if(!(digitalRead(resetButton))) break;
        delay(20);
      }
      x = random(50, 70);
      y = random(border + radius + 5, maxHeight - 5);
      compScore = 0;
      userScore = 0;
    }
}